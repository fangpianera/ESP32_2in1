## firmware/app_nav/sdkconfig.defaults
```kconfig
# EVA-Nav 板级基线配置
# 依据：waveshare_boards/boards/esp32_s3_touch_amoled_1_75c/sdkconfig.defaults.board
#      + examples/esp-idf/02_lvgl_demo_v9/sdkconfig.defaults

# ---- Flash / PSRAM ----
CONFIG_ESPTOOLPY_FLASHMODE_QIO=y
CONFIG_ESPTOOLPY_FLASHSIZE_32MB=y
CONFIG_ESPTOOLPY_FLASHFREQ_80M=y
CONFIG_PARTITION_TABLE_CUSTOM=y
CONFIG_PARTITION_TABLE_CUSTOM_FILENAME="partitions_dual.csv"

CONFIG_SPIRAM=y
CONFIG_SPIRAM_MODE_OCT=y
CONFIG_SPIRAM_SPEED_80M=y
CONFIG_SPIRAM_FETCH_INSTRUCTIONS=y
CONFIG_SPIRAM_RODATA=y
CONFIG_SPIRAM_MALLOC_ALWAYSINTERNAL=0
CONFIG_SPIRAM_TRY_ALLOCATE_WIFI_LWIP=y
CONFIG_SPIRAM_ALLOW_BSS_SEG_EXTERNAL_MEMORY=y
CONFIG_SPIRAM_ALLOW_NOINIT_SEG_EXTERNAL_MEMORY=y

CONFIG_ESP_DEFAULT_CPU_FREQ_MHZ_240=y
CONFIG_ESP32S3_DATA_CACHE_64KB=y
CONFIG_ESP32S3_DATA_CACHE_LINE_64B=y
CONFIG_ESP_CONSOLE_USB_SERIAL_JTAG=y
CONFIG_COMPILER_OPTIMIZATION_PERF=y

# ---- FreeRTOS ----
CONFIG_FREERTOS_HZ=1000

# ---- LVGL 9.5 ----
CONFIG_LV_COLOR_DEPTH_16=y
CONFIG_LV_OS_FREERTOS=y
CONFIG_LV_DEF_REFR_PERIOD=15
CONFIG_LV_USE_CLIB_MALLOC=y
CONFIG_LV_USE_CLIB_STRING=y
CONFIG_LV_USE_CLIB_SPRINTF=y
CONFIG_LV_OBJ_STYLE_CACHE=y
CONFIG_LV_DRAW_SW_DRAW_UNIT_CNT=2
CONFIG_LV_ATTRIBUTE_FAST_MEM_USE_IRAM=n
CONFIG_LV_USE_FONT_COMPRESSED=y
# 字体内置全部关闭：UI 用 fonts/eva_tech_48/20/15.c（Flash 常量），中文用 nav18（LittleFS 或内嵌）
# [实测]改前 MONTSERRAT_14/48 常驻只是占 Flash；res_mgr 的 num48 兜底已改指向 eva_tech_48
# CONFIG_LV_FONT_MONTSERRAT_14 is not set
# CONFIG_LV_FONT_MONTSERRAT_48 is not set
# LVGL 自带性能/内存监视浮层默认关：它会在屏幕角落画白色小字，
# [实测]实拍里被看成"右下角一个白点"，且每帧刷新白烧 CPU。
# 需要现场看帧率时临时改回 y 即可（注意 PERF/MEM 均依赖 SYSMON）。
CONFIG_LV_USE_SYSMON=n
CONFIG_LV_USE_PERF_MONITOR=n
CONFIG_LV_USE_MEM_MONITOR=n

# ---- LittleFS ----
CONFIG_LITTLEFS_READ_SIZE=256
CONFIG_LITTLEFS_PAGE_SIZE=256
CONFIG_LITTLEFS_OBJ_NAME_LEN=64

# ---- OTA 回滚（A/B）----
CONFIG_BOOTLOADER_APP_ROLLBACK_ENABLE=y
CONFIG_APP_PROJECT_VER_FROM_CONFIG=y
CONFIG_APP_PROJECT_VER="0.9.0-arch"

# ---- 看门狗：融合任务 100Hz，10s 超时足够暴露卡死又不误杀慢速闪写 ----
CONFIG_ESP_TASK_WDT_TIMEOUT_S=10
CONFIG_ESP_TASK_WDT_CHECK_IDLE_TASK_CPU0=n

# ---- BLE / NimBLE（主传输，见 main/app_cfg.h EVA_LINK_BLE）----
CONFIG_BT_ENABLED=y
CONFIG_BT_NIMBLE_ENABLED=y
CONFIG_BT_NIMBLE_ROLE_PERIPHERAL=y
CONFIG_BT_NIMBLE_ROLE_CENTRAL=n
CONFIG_BT_NIMBLE_ROLE_OBSERVER=n
CONFIG_BT_NIMBLE_ROLE_BROADCASTER=y
# MTU 517：路线 JSON 几十 KB，用默认 23 会慢到不可接受
CONFIG_BT_NIMBLE_ATT_PREFERRED_MTU=517
CONFIG_BT_NIMBLE_MAX_CONNECTIONS=2
CONFIG_BT_NIMBLE_NVS_PERSIST=n
CONFIG_BT_NIMBLE_HOST_TASK_STACK_SIZE=5120

# BLE-only build: 彻底关掉 Wi-Fi，释放 IRAM/heap（Wi-Fi 的 iram1 代码会把 _xt_debugexception 顶出 ±128KB 的 j 范围）
CONFIG_ESP_WIFI_ENABLED=n
CONFIG_LV_FONT_FMT_TXT_LARGE=y
```
